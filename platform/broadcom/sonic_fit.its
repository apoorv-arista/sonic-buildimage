## platform/broadcom/sonic_fit.its
```
/*
 * SONiC BMC U-Boot FIT Image for Broadcom ARM64
 * For QEMU/KVM virtualization
 */

/dts-v1/;

/ {
    description = "U-Boot fitImage for SONiC BMC Broadcom ARM64";
    #address-cells = <1>;

    images {
        kernel {
            description = "Linux Kernel ARM64";
            data = /incbin/("/boot/vmlinuz-6.1.0-29-2-arm64");
            type = "kernel";
            arch = "arm64";
            os = "linux";
            compression = "none";
            load = <0x80080000>;
            entry = <0x80080000>;
            hash@1 {
                algo = "sha1";
            };
        };

        ramdisk {
            description = "Initial RAM Disk";
            data = /incbin/("/boot/initrd.img-6.1.0-29-2-arm64");
            type = "ramdisk";
            arch = "arm64";
            os = "linux";
            compression = "gzip";
            load = <0x85000000>;
            entry = <0x85000000>;
            hash@1 {
                algo = "sha1";
            };
        };
    };

    configurations {
        default = "bmc_broadcom";

        bmc_broadcom {
            description = "SONiC BMC Broadcom ARM64 Configuration";
            kernel = "kernel";
            ramdisk = "ramdisk";
            hash@1 {
                algo = "sha1";
            };
        };
    };
};
```
